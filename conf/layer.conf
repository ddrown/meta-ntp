## conf/layer.conf
```bitbake
# We have a conf and classes directory, add to BBPATH
BBPATH .= ":${LAYERDIR}"

# We have recipes-* directories, add to BBFILES
BBFILES += "${LAYERDIR}/recipes-*/*/*.bb \
            ${LAYERDIR}/recipes-*/*/*.bbappend"

BBFILE_COLLECTIONS += "meta-ntp"
BBFILE_PATTERN_meta-ntp = "^${LAYERDIR}/"
BBFILE_PRIORITY_meta-ntp = "7"

LAYERDEPENDS_meta-ntp = "core"
LAYERSERIES_COMPAT_meta-ntp = "thud"
```
